## sdkconfig.defaults
```kconfig
# ESP32-S3 Audio Reactive Face Configuration

# Bluetooth Configuration
CONFIG_BT_ENABLED=y
CONFIG_BT_BLUEDROID_ENABLED=y
CONFIG_BT_CLASSIC_ENABLED=y

# ESP32-S3 Configuration
CONFIG_IDF_TARGET_ESP32S3=y
CONFIG_ESP_DEFAULT_CPU_FREQ_MHZ_240=y

# LCD Performance
CONFIG_SPI_MASTER_IN_IRAM=y

# Memory Optimization
CONFIG_BT_BTC_TASK_STACK_SIZE=4096
CONFIG_BT_BTU_TASK_STACK_SIZE=4096
```
